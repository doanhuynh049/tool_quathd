## meta-layer/conf/layer.conf
```bitbake
# We have a conf and classes directory, add to BBPATH
BBPATH .= ":${LAYERDIR}"

# We have recipes-* directories, add to BBFILES
BBFILES += "${LAYERDIR}/recipes-*/*/*.bb \
            ${LAYERDIR}/recipes-*/*/*.bbappend"

BBFILE_COLLECTIONS += "meta-layer"
BBFILE_PATTERN_meta-layer = "^${LAYERDIR}/"
BBFILE_PRIORITY_meta-layer = "6"

LAYERDEPENDS_meta-layer = "core"
LAYERSERIES_COMPAT_meta-layer = "dunfell"
```
